## drivers/display/Kconfig.pse84_gfxss
```kconfig
# Copyright (c) 2026 Dan Ahern
# SPDX-License-Identifier: Apache-2.0

config DISPLAY_PSE84_GFXSS
	bool "Infineon PSE84 GFXSS display controller"
	default y
	depends on DT_HAS_INFINEON_PSE84_GFXSS_ENABLED
	depends on SOC_FAMILY_INFINEON_EDGE
	select USE_INFINEON_GFXSS
	help
	  Enable the Infineon PSE84 GFXSS (Graphics Subsystem) display
	  controller driver. Wraps the Cypress HAL (Cy_GFXSS_Init) and
	  exposes the standard Zephyr display_driver_api. Operates the
	  DSI link in VIDEO mode: the DC autonomously scans the
	  framebuffer in SOCMEM after init. display_write() copies
	  pixels into the FB with a D-cache clean so the DC picks them
	  up on the next vsync.

if DISPLAY_PSE84_GFXSS

config DISPLAY_PSE84_GFXSS_PANEL_INIT_DELAY_MS
	int "Panel MCU stabilization delay (ms)"
	default 250
	help
	  How long to wait after Cy_GFXSS_Init before calling the panel's
	  init function. The Waveshare 4.3" MCU panel needs ~250 ms after
	  the DSI link comes up before it will respond to I2C commands.

endif # DISPLAY_PSE84_GFXSS
```

## drivers/display/Kconfig.waveshare_dsi_4p3_mcu
```kconfig
# Copyright (c) 2026 Dan Ahern
# SPDX-License-Identifier: Apache-2.0

config WAVESHARE_DSI_4P3_MCU
	bool "Waveshare 4.3\" MIPI-DSI panel with on-board MCU"
	default y
	depends on DT_HAS_WAVESHARE_DSI_4P3_MCU_ENABLED
	depends on I2C
	help
	  Driver for the Waveshare 4.3" MIPI-DSI display with on-board MCU
	  (800x480). The MCU exposes an I2C register set for power, enable,
	  brightness at address 0x45; register layout is distinct from the
	  bare ICN6211 handled by WAVESHARE_DSI2DPI. Intended to be driven
	  by a host display controller (e.g. infineon,pse84-gfxss); the
	  panel node is typically marked 'zephyr,deferred-init' so the host
	  can run the panel init with device_init() after the DSI link is up.
```

## drivers/mbox/Kconfig.pse84
```kconfig
# Copyright (c) 2026 PSE84 Voice Assistant contributors
# SPDX-License-Identifier: Apache-2.0

config MBOX_PSE84
	bool "Infineon PSE84 IPC mailbox driver"
	default y
	depends on DT_HAS_INFINEON_PSE84_MBOX_ENABLED
	help
	  Driver for the Infineon PSE84 IPC mailbox, wrapping the
	  Cy_IPC_Drv_* PDL primitives into Zephyr's mbox driver API.
	  Phase 0b scaffolding for the M33 <-> M55 voice-assistant IPC.
```

## dts/bindings/display/infineon,pse84-gfxss.yaml
```yaml
#
# Copyright (c) 2026 Dan Ahern
#
# SPDX-License-Identifier: Apache-2.0
#

description: |
  Infineon PSE84 GFXSS (Graphics Subsystem) display controller.

  The GFXSS bundles a Vivante DCNano display controller, a MIPI DSI host
  (Synopsys DWC), and an optional GPU into one IP block at 0x44800000.
  The framebuffer is backed by SOCMEM (DC reads via a dedicated DMA port,
  not from main SRAM).

  This driver wraps the Cypress HAL (Cy_GFXSS_Init) and exposes the standard
  Zephyr display_driver_api. It operates the DSI link in VIDEO mode: after
  initialization the DC autonomously scans the framebuffer. Software writes
  pixels into the FB via display_write() and a D-cache clean ensures the DC
  sees the update on the next vsync.

  The DSI D-PHY PLL reference is CLK_HF12. The driver expects the board DT
  to have already routed a suitable clock into HF12 (e.g. via clk_ext →
  path_mux4 → clk_hf12 on the KIT_PSE84_EVAL, which wires a 24 MHz external
  clock to P7[4]/srss.ext_clk). It fails fast if HF12 reads 0 Hz at init.

compatible: "infineon,pse84-gfxss"

include: [lcd-controller.yaml]

properties:
  reg:
    required: true

  framebuffer:
    type: phandle
    required: true
    description: |
      Phandle to a memory node describing where the framebuffer lives
      in SOCMEM. The referenced node must have a 'reg' property whose
      size is at least stride_pixels * height * bytes_per_pixel (see
      'stride-pixels'). The driver reads the address and size via
      DT_REG_ADDR / DT_REG_SIZE and writes pixels there directly; the
      node does not need to be a zephyr,memory-region because the CM55
      linker does not own SOCMEM.

  stride-pixels:
    type: int
    description: |
      Row stride of the framebuffer in pixels. If unset, defaults to 'width'.
      On PSE84 the DC requires the row stride in bytes to be 128-byte
      aligned, so panels whose width does not satisfy that constraint need
      stride-pixels > width. For example, an RGB565 800-pixel-wide panel
      needs stride-pixels = 832 (832*2 = 1664 = 13*128). The tail pixels
      in each row are included in the DSI hactive so the DSI-to-RGB bridge
      on the panel can fetch them; the bridge itself is responsible for
      cropping to the physical display width.

  num-lanes:
    type: int
    required: true
    description: Number of MIPI DSI data lanes (1 for the Waveshare 4.3").

  per-lane-mbps:
    type: int
    required: true
    description: Per-lane DSI line rate in megabits per second (810 for 4.3").

  pixel-clock-khz:
    type: int
    required: true
    description: |
      DPI pixel clock in kHz. Computed as
        (hsync_width + hfp + hbp + width) *
        (vsync_width + vfp + vbp + height) * fps / 1000

  hsync-width:
    type: int
    required: true

  hfp:
    type: int
    required: true
    description: Horizontal front porch in pixel clocks.

  hbp:
    type: int
    required: true
    description: Horizontal back porch in pixel clocks.

  vsync-width:
    type: int
    required: true

  vfp:
    type: int
    required: true
    description: Vertical front porch in lines.

  vbp:
    type: int
    required: true
    description: Vertical back porch in lines.

# Panel association is resolved at compile time via DEVICE_DT_GET_ANY()
# on a known panel compatible (e.g. waveshare,dsi-4p3-mcu), not by a
# phandle property, so the EDT init priority validator does not see a
# dependency from this node to the panel. This lets the panel be marked
# 'zephyr,deferred-init' (required for panels whose control interface
# only responds after the DSI link is already transmitting) without
# blocking GFXSS bring-up.
```

## dts/bindings/display/waveshare,dsi-4p3-mcu.yaml
```yaml
#
# Copyright (c) 2026 Dan Ahern
#
# SPDX-License-Identifier: Apache-2.0
#

description: |
  Waveshare 4.3" MIPI-DSI display with on-board MCU.

  This board hosts an ICN6211 DSI-to-RGB bridge + an Atmel-style MCU that
  sequences the bridge and LCD power. The MCU exposes a small register set
  over I2C at address 0x45:

    0x80  device ID (read, returns 0xC3)
    0x81  power control (write 0x04 to power on)
    0x85  display enable (0x00 = off, 0x01 = on)
    0x86  brightness (0x00..0xFF)

  This is distinct from the bare ICN6211 boards handled by the existing
  'waveshare,dsi2dpi' binding which uses a completely different register
  set (0xc0, 0xc2, 0xac, 0xab, 0xaa, 0xad).

  The panel is driven by a host display controller (the GFXSS on PSE84).
  Its init sequence must run *after* the host DSI link is already
  transmitting, so this node is typically marked 'zephyr,deferred-init'
  and the host driver calls device_init() on the panel phandle after
  its own bring-up plus a stabilization delay.

compatible: "waveshare,dsi-4p3-mcu"

include: [base.yaml]

on-bus: i2c

properties:
  reg:
    required: true
    description: I2C address of the panel MCU (0x45 on the standard board).

  default-brightness:
    type: int
    default: 255
    description: Brightness value written to 0x86 during init (0..255).
```

## dts/bindings/flash_controller/infineon,qspi-flash.yaml
```yaml
description: |
  Infineon CAT1 SMIF flash controller.

  This binding covers both the QSPI (Quad-SPI 1-4-4) and OSPI (Octal-SPI 1-8-8
  or 8-8-8 DDR) operating modes of the Infineon SMIF IP. The default property
  values match the legacy Quad SDR operation on chip-select 1 that existed
  before these properties were introduced, so boards that do not set any of
  the new properties get exactly the same behavior as before.

  The driver reads these properties from the controller node and uses them
  when it calls mtb_serial_memory_setup() into the hal_infineon serial-memory
  helper, which in turn configures the SMIF register block and (for octal
  memories) runs Cy_SMIF_MemOctalEnable().

compatible: "infineon,qspi-flash"

include: flash-controller.yaml

properties:
  chip-select:
    type: int
    default: 1
    enum:
      - 0
      - 1
      - 2
      - 3
    description: |
      SMIF chip-select (0..3) to use for the single memory the driver owns.
      Defaults to 1 to match the historical hardcoded behavior
      (MTB_SERIAL_MEMORY_CHIP_SELECT_1) used by the S25FS128S on CS1 of
      kit_pse84_eval.

  io-mode:
    type: string
    default: "quad"
    enum:
      - "single"
      - "dual"
      - "quad"
      - "octal"
    description: |
      Bus width used for the read/program command data phase. Maps to
      CY_SMIF_WIDTH_SINGLE / _DUAL / _QUAD / _OCTAL for the corresponding
      deviceCfg entry in the memslot configuration. Defaults to "quad"
      to match legacy behavior. Selecting "octal" requires the memslot
      declaration to provide an Octal-capable command set; see the
      cycfg_qspi_memslot.c file in the zephyr-ifx-cycfg west module.

  data-rate:
    type: string
    default: "sdr"
    enum:
      - "sdr"
      - "ddr"
    description: |
      Data rate used on the SMIF bus. "sdr" is single data rate (one bit
      per clock edge); "ddr" is double data rate (used by Octal DDR /
      xSPI / HyperBus-style devices). Maps to CY_SMIF_SDR / CY_SMIF_DDR
      on the memslot read command.

  rx-capture-mode:
    type: string
    default: "normal-spi"
    enum:
      - "normal-spi"
      - "normal-spi-with-dlp"
      - "xspi-hyperbus-with-dqs"
    description: |
      RX capture mode for the SMIF receive path. Maps to
      cy_en_smif_capture_mode_t. "normal-spi" matches legacy SDR Quad
      operation. "xspi-hyperbus-with-dqs" is required for Octal DDR
      with a data-strobe signal (typical for Infineon SEMPER Octal NOR
      and HyperRAM devices).

  smif-frequency:
    type: int
    default: 50000000
    description: |
      SMIF bus pin frequency in Hz after the controller's internal /2
      divider. 50 MHz is safe for Quad SDR. 200 MHz is typical for
      Octal DDR with DQS/DLL calibration. Must be paired with an
      appropriate data-rate and rx-capture-mode.
```

## modules/hal_infineon/Kconfig
```kconfig
# Copyright (c) 2022 Cypress Semiconductor Corporation.
# SPDX-License-Identifier: Apache-2.0

config ZEPHYR_HAL_INFINEON_MODULE
	bool

config ZEPHYR_HAL_INFINEON_MODULE_BLOBS
	bool

if SOC_FAMILY_INFINEON_CAT1 || SOC_FAMILY_INFINEON_EDGE || SOC_FAMILY_PSOC6_LEGACY || SOC_FAMILY_INFINEON_PSOC4

config USE_INFINEON_LEGACY_HAL
	bool
	help
	  Use Legacy HAL driver instead of PDL based drivers.  This allows devices to use HAL based
	  drivers until fully transitioned to the PDL.  The old HAL drivers will be removed when all
	  devices have been transitioned.

config USE_INFINEON_ADC
	bool
	help
	  Enable Analog-to-Digital Converter (ADC) HAL module driver for Infineon devices

config USE_INFINEON_HPPASS_SAR_ADC
	bool
	help
	  Enable Infineon HPPASS SAR ADC PDL library support

config USE_INFINEON_HPPASS_ANALOG
	bool
	help
	  Enable Infineon HPPASS Analog PDL library support

config USE_INFINEON_AUTANALOG_SAR_ADC
	bool
	help
	  Enable AutAnalog SAR ADC HAL module driver for Infineon devices

config USE_INFINEON_DMA
	bool
	help
	  Enable DMA HAL module driver for Infineon devices

config USE_INFINEON_I2C
	bool
	help
	  Enable Inter-Integrated Circuit Interface (I2C) HAL module driver for Infineon devices

config USE_INFINEON_GFXSS
	bool "Infineon GFXSS HAL (PSE84 display controller)"
	help
	  Enable Graphics Subsystem (GFXSS) HAL driver: cy_graphics, cy_mipidsi, and
	  the DCNano viv kernel sources for the PSE84 display controller.

config USE_INFINEON_I3C
	bool
	help
	  Enable Improved Inter-Integrated Circuit Interface (I3C) HAL module driver for Infineon devices

config USE_INFINEON_I2S
	bool
	help
	  Enable Inter-Integrated Sound Interface (I2S) HAL module driver for Infineon devices

config USE_INFINEON_PDM_PCM
	bool
	help
	  Enable PDM-PCM HAL module driver for Infineon devices

config USE_INFINEON_RTC
	bool
	help
	  Enable Real-Time Clock (RTC) HAL module driver for Infineon devices

config USE_INFINEON_SDIO
	bool
	help
	  Enable Secure Digital Input/Output interface (SDIO) HAL module for Infineon devices
	  driver

config USE_INFINEON_SDHC
	bool
	help
	  Enable SDHC HAL module for Infineon devices
	  driver

config USE_INFINEON_SPI
	bool
	help
	  Enable Serial Peripheral Interface (SPI) HAL module driver for Infineon devices


config USE_INFINEON_TIMER
	bool
	help
	  Enable Timer (Timer/Counter) HAL module driver for Infineon devices

config USE_INFINEON_LPTIMER
	bool
	help
	  Enable Low-Power Timer (LPTimer) HAL module driver for Infineon devices

config USE_INFINEON_TRNG
	bool
	help
	  Enable True Random Number Generator (TRNG) HAL module driver for Infineon devices

config USE_INFINEON_UART
	bool
	help
	  Enable Universal Asynchronous Receiver/Transmitter (UART) HAL module
	  driver for Infineon devices

config USE_INFINEON_PWM
	bool
	help
	  Enable Pulse Width Modulator (PWM) HAL module driver for Infineon devices

config USE_INFINEON_WDT
	bool
	help
	  Enable WATCHDOG TIMER (WDT) HAL module
	  driver for Infineon devices

config USE_INFINEON_FLASH
	bool
	help
	  Enable Flash HAL module driver for Infineon devices

config USE_INFINEON_SMIF
	bool
	help
	  Enable SMIF HAL driver for Infineon devices

config INFINEON_SMIF_OCTAL
	bool "Use Infineon SEMPER Octal NOR flash (PSE84 only)"
	depends on SOC_SERIES_PSE84
	help
	  Route SMIF0 on KIT_PSE84_EVAL through the 128 MB Infineon SEMPER
	  S28HS01GTGZBHI030 Octal NOR flash on chip-select 0 in OPI DDR mode
	  instead of the default 16 MB S25FS128S Quad NOR on chip-select 1.
	  This selects the alternate cycfg_qspi_memslot_octal.c file (emitted
	  by the ModusToolbox QSPI Configurator with the pre-canned
	  "Octal DDR Hybrid at Bottom 25 MHz" preset) and changes the flash
	  base address layout to match the octal 64 MB per-aperture SMIF0 map.

	  The Octal and Quad flashes on this board share DQ0..3 so only one
	  can be electrically active at a time — selecting this symbol
	  commits the whole boot chain (storage, m33s_xip, m33_xip, m55_xip)
	  to the octal chip.

	  EXPERIMENTAL — boot-from-octal requires the M33 secure image to
	  reconfigure SMIF from the ROM-default mode to OPI DDR during its
	  own early init, from SRAM-resident code. See the octal enablement
	  plan at zephyr_workspace/PSE84_OCTAL_FLASH_ENABLEMENT_PLAN.md.

endif # SOC_FAMILY_INFINEON_CAT1 || SOC_FAMILY_INFINEON_EDGE || SOC_FAMILY_PSOC6_LEGACY || SOC_FAMILY_INFINEON_PSOC4

config USE_INFINEON_ABSTRACTION_RTOS
	bool "Abstraction RTOS component (Zephyr support)"
	help
	  Enable Abstraction RTOS component with Zephyr support
```
