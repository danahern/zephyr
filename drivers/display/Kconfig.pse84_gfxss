## soc/infineon/edge/pse84/Kconfig
```kconfig
# Copyright (c) 2025 Infineon Technologies AG,
# or an affiliate of Infineon Technologies AG.
#
# SPDX-License-Identifier: Apache-2.0

config SOC_SERIES_PSE84
	select ARM
	select CPU_HAS_FPU
	select ARMV8_M_DSP
	select CPU_HAS_ARM_MPU
	select BUILD_OUTPUT_HEX
	select BUILD_OUTPUT_BIN
	select DYNAMIC_INTERRUPTS
	select SOC_EARLY_INIT_HOOK
	select HAS_PM
	select CPU_HAS_CUSTOM_FIXED_SOC_MPU_REGIONS

config SOC_SERIES_PSE84_M33
	select CPU_CORTEX_M33
	select CPU_HAS_ARM_SAU
	select ARM_TRUSTZONE_M
	select ARCH_HAS_TRUSTED_EXECUTION

config SOC_SERIES_PSE84_M55
	select CPU_CORTEX_M55
	select ARMV8_1_M_MVEI
	select ARMV8_1_M_MVEF
	select CACHE_MANAGEMENT

config SOC_SERIES_PSE84_M33
	select SOC_LATE_INIT_HOOK

if SOC_SERIES_PSE84_M33

config SOC_PSE84_M55_ENABLE
	bool "pse84 m55 core is enabled during setup"
	help
	  This option enables the m55 core on pse84, by m33 core.

config INFINEON_EXTENDED_BOOT_DID_PPC
	bool "Skip cy_ppc_init (extended boot already ran it)"
	depends on SOC_PSE84_M55_ENABLE
	help
	  When the OEM policy's extended-boot has already attributed PPC
	  regions (e.g. policy_oem_octal with oem_alt_boot=true on
	  kit_pse84_eval), re-running cy_ppc0_init()/cy_ppc1_init() in
	  ifx_pse84_cm55_startup bus-faults on SCB Secure registers
	  (observed BFAR=0x529a0000 on 2026-04-15). Set y to skip and
	  also re-enable IRQs after cy_mpc_init so main() can execute.

endif # SOC_SERIES_PSE84_M33
```

## tests/drivers/build_all/display/testcase.yaml
```yaml
common:
  build_only: true
  tags:
    - drivers
    - display

tests:
  drivers.display.build.default:
    integration_platforms:
      - native_sim
      - native_sim/native/64
    depends_on: display

  drivers.display.build.bflb_dbi:
    platform_allow:
      - ai_m62_12f_kit

  drivers.display.build.sf32lb_dbi:
    platform_allow:
      - sf32lb52_devkit_lcd

  drivers.display.build.pse84_gfxss:
    platform_allow:
      - kit_pse84_eval/pse846gps2dbzc4a/m55
    depends_on: display
```
